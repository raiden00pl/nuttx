## boards/arm/stm32h7/openh743i/Kconfig
```kconfig
#
# For a description of the syntax of this configuration file,
# see the file kconfig-language.txt in the NuttX tools repository.
#

if ARCH_BOARD_OPENH743I

choice
	prompt "OPENH743I USART console selection"
	default OPENH743I_CONSOLE_USART1

config OPENH743I_CONSOLE_NONE
	bool "No console"

config OPENH743I_CONSOLE_USART1
	bool "Console on USART1"
	select STM32H7_USART1
	select USART1_SERIAL_CONSOLE

config OPENH743I_CONSOLE_USART3
	bool "Console on USART3"
	select STM32H7_USART3
	select USART3_SERIAL_CONSOLE

endchoice # OPENH743I USART selection

config OPENH743I_DISABLE_OTGFS_PWRON
	bool "Disable OTGFS PWRON pin"
	depends on USBHOST
	default n
	---help---
		This option disable PWRON pin control from MCU.
		Setting PWRON in high state somehow breaks USBDEV on OTGHS.
		If both OTG peripherals are used, and OTGFS is used as HOST,
		then the power switch enable pin must be set directly from 3.3V bus.

endif # ARCH_BOARD_OPENH743I
```

## boards/x86_64/intel64/qemu-intel64/Kconfig
```kconfig
#
# For a description of the syntax of this configuration file,
# see the file kconfig-language.txt in the NuttX tools repository.
#
#

if ARCH_BOARD_INTEL64_QEMU

config INTEL64_QEMU_RAMDISK
	bool "RAMDISK support"
	default n

endif
```

## drivers/motor/foc/Kconfig
```kconfig
menuconfig MOTOR_FOC
	bool "FOC (Field Oriented Controller) driver support"
	default n
	---help---
		Enables building of the "upper-half" FOC driver.

if MOTOR_FOC

config MOTOR_FOC_INST
	int "FOC instances"
	default 1

config MOTOR_FOC_PHASES
	int "FOC phases number"
	default 3

config MOTOR_FOC_SHUNTS
	int "FOC number of shunts"
	range 1 3
	default 3
	---help---
		Number of shunts supported (or other types of current sensors).
		Any current reconstruction must be done on the lower-half side.

config MOTOR_FOC_TRACE
	bool "FOC trace support"
	default n
	---help---
		Enables FOC driver trace interface.

config MOTOR_FOC_DUMMY
	bool "Simulated FOC device"
	default n
	---help---
		Build a simulated lower-half FOC device

choice
	prompt "FOC currents type"
	default MOTOR_FOC_CURR_TYPE_INT32

config MOTOR_FOC_CURR_TYPE_INT32
	bool "FOC driver use int32_t for currents"

endchoice # FOC currents type

choice
	prompt "FOC duty cycles type"
	default MOTOR_FOC_DUTY_TYPE_INT32

config MOTOR_FOC_DUTY_TYPE_UB16
	bool "FOC driver use ub16_t for duty cycles"

endchoice # FOC duty cycles type

endif #MOTOR_FOC
```

## drivers/pci/Kconfig
```kconfig
#
# For a description of the syntax of this configuration file,
# see the file kconfig-language.txt in the NuttX tools repository.
#

menuconfig PCI
	bool "Support for PCI Bus"
	default n
	---help---
		Enables support for the PCI bus.
		Backend bust be provided by per-arch or per-board implementation.

config PCI_MSIX
	bool "PCI MSIX support"
	depends on EXPERIMENTAL
	default n
```

## drivers/virt/Kconfig
```kconfig
#
# For a description of the syntax of this configuration file,
# see the file kconfig-language.txt in the NuttX tools repository.
#
#
#
menuconfig VIRT
	bool "Virtualization"
	default n
	---help---
		Drivers for virtualized and emulated devices

if VIRT

config VIRT_QEMU_PCI_TEST
	bool "Driver for QEMU PCI test device"
	default n
	select PCI
	---help---
		Driver for QEMU PCI test device

config VIRT_QEMU_EDU
	bool "Driver for QEMU EDU test device"
	default n
	select PCI
	---help---
		Driver for QEMU EDU test device

config VIRT_IVSHMEM
	bool "IVSHMEM (v1)"
	default n
	select PCI
	---help---
		Driver for IVSHMEM PCI device

if VIRT_IVSHMEM

config VIRT_IVSHMEM_DOORBELL
	bool "IVSHMEM Doorbell support (interrupts)"
	default n

config VIRT_IVSHMEM_DOORBEL_VECTORS
	int "IVSHMEM Doorbell vectors supported"
	default 1
	depends on VIRT_IVSHMEM_DOORBEL

endif # VIRT_IVSHMEM

endif # VIRT
```
