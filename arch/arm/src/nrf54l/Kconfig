## arch/arm/src/nrf54l/Kconfig
```kconfig
#
# For a description of the syntax of this configuration file,
# see the file kconfig-language.txt in the NuttX tools repository.
#

comment "nRF54L Configuration Options"

# nRF54L Families

choice
	prompt "nRF54L Chip Selection"
	default ARCH_CHIP_NRF54L15
	depends on ARCH_CHIP_NRF54L

config ARCH_CHIP_NRF54L15
	bool "nRF54L15"

config ARCH_CHIP_NRF54LM20A
	bool "nRF54LM20A"

config ARCH_CHIP_NRF54LM20B
	bool "nRF54LM20B"

endchoice # nRF54L Chip Selection

# Peripheral Selection

config NRF54L_SPI_MASTER
	bool
	default n
	select SPI
	select ARCH_HAVE_SPI_BITORDER

config NRF54L_UART
	bool
	default n

config NRF54L_TIMER
	bool
	default n

config NRF54L_PWM
	bool
	default n

menu "nRF54L Peripheral Selection"

config NRF54L_GPIOTE
	bool "GPIOTE (GPIO interrupts)"
	default n

config NRF54L_SPI0_MASTER
	bool "SPI0 Master (SPIM20)"
	default n
	depends on !NRF54L_UART0
	select NRF54L_SPI_MASTER

config NRF54L_SPI1_MASTER
	bool "SPI1 Master (SPIM21)"
	default n
	depends on !NRF54L_UART1
	select NRF54L_SPI_MASTER

config NRF54L_SPI2_MASTER
	bool "SPI2 Master (SPIM22)"
	default n
	depends on !NRF54L_UART2
	select NRF54L_SPI_MASTER

config NRF54L_SPI3_MASTER
	bool "SPI3 Master (SPIM30)"
	default n
	depends on !NRF54L_UART3
	select NRF54L_SPI_MASTER

config NRF54L_SPI4_MASTER
	bool "SPI4 Master (SPIM00)"
	default n
	depends on !NRF54L_UART4
	select NRF54L_SPI_MASTER

config NRF54L_SPI5_MASTER
	bool "SPI5 Master (SPIM23)"
	default n
	depends on !ARCH_CHIP_NRF54L15 && !NRF54L_UART5
	select NRF54L_SPI_MASTER

config NRF54L_SPI6_MASTER
	bool "SPI6 Master (SPIM24)"
	default n
	depends on !ARCH_CHIP_NRF54L15 && !NRF54L_UART6
	select NRF54L_SPI_MASTER

config NRF54L_UART0
	bool "UART0"
	default n
	select UART0_SERIALDRIVER
	select NRF54L_UART
	---help---
		Enable UART0 (UARTE20). The board must provide
		BOARD_UART0_TX_PIN and BOARD_UART0_RX_PIN.

config NRF54L_UART1
	bool "UART1"
	default n
	select UART1_SERIALDRIVER
	select NRF54L_UART
	---help---
		Enable UART1 (UARTE21). The board must provide
		BOARD_UART1_TX_PIN and BOARD_UART1_RX_PIN.

config NRF54L_UART2
	bool "UART2"
	default n
	select UART2_SERIALDRIVER
	select NRF54L_UART
	---help---
		Enable UART2 (UARTE22). The board must provide
		BOARD_UART2_TX_PIN and BOARD_UART2_RX_PIN.

config NRF54L_UART3
	bool "UART3"
	default n
	select UART3_SERIALDRIVER
	select NRF54L_UART
	---help---
		Enable UART3 (UARTE30). The board must provide
		BOARD_UART3_TX_PIN and BOARD_UART3_RX_PIN.

config NRF54L_UART4
	bool "UART4"
	default n
	select UART4_SERIALDRIVER
	select NRF54L_UART
	---help---
		Enable UART4 (UARTE00). The board must provide
		BOARD_UART4_TX_PIN and BOARD_UART4_RX_PIN.

config NRF54L_UART5
	bool "UART5"
	default n
	depends on ARCH_CHIP_NRF54LM20A || ARCH_CHIP_NRF54LM20B
	select UART5_SERIALDRIVER
	select NRF54L_UART
	---help---
		Enable UART5 (UARTE23). The board must provide
		BOARD_UART5_TX_PIN and BOARD_UART5_RX_PIN.

config NRF54L_UART6
	bool "UART6"
	default n
	depends on ARCH_CHIP_NRF54LM20A || ARCH_CHIP_NRF54LM20B
	select UART6_SERIALDRIVER
	select NRF54L_UART
	---help---
		Enable UART6 (UARTE24). The board must provide
		BOARD_UART6_TX_PIN and BOARD_UART6_RX_PIN.

config NRF54L_TIMER0
	bool "TIMER0 (TIMER20)"
	select NRF54L_TIMER
	default n

config NRF54L_TIMER1
	bool "TIMER1 (TIMER21)"
	select NRF54L_TIMER
	default n

config NRF54L_TIMER2
	bool "TIMER2 (TIMER22)"
	select NRF54L_TIMER
	default n

config NRF54L_TIMER3
	bool "TIMER3 (TIMER23)"
	select NRF54L_TIMER
	default n

config NRF54L_TIMER4
	bool "TIMER4 (TIMER24)"
	select NRF54L_TIMER
	default n

config NRF54L_TIMER5
	bool "TIMER5 (TIMER00)"
	select NRF54L_TIMER
	default n

config NRF54L_TIMER6
	bool "TIMER6 (TIMER10)"
	select NRF54L_TIMER
	default n

config NRF54L_PWM0
	bool "PWM0 (PWM20)"
	select NRF54L_PWM
	depends on PWM
	default n

config NRF54L_PWM1
	bool "PWM1 (PWM21)"
	select NRF54L_PWM
	depends on PWM
	default n

config NRF54L_PWM2
	bool "PWM2 (PWM22)"
	select NRF54L_PWM
	depends on PWM
	default n

config NRF54L_SAADC
	bool "SAADC"
	default n

config NRF54L_GRTC
	bool "GRTC"
	default n

endmenu # nRF54L Peripheral Selection

menu "System Timer"

choice
	prompt "System Timer Source"
	default NRF54L_SYSTIMER_SYSTICK

config NRF54L_SYSTIMER_SYSTICK
	bool "SysTick"
	select TIMER
	select TIMER_ARCH
	select ARMV8M_SYSTICK

config NRF54L_SYSTIMER_GRTC
	bool "GRTC"
	select NRF54L_GRTC
	select ARCH_HAVE_TICKLESS
	select SCHED_TICKLESS
	select SCHED_TICKLESS_ALARM
	---help---
		Use the GRTC 1 MHz system counter and compare channel zero
		for tickless scheduling. The counter is kept active and uses
		the internal low-power RC oscillator as its LF clock source.

endchoice # System Timer Source

endmenu # System Timer

config NRF54L_DEBUG_ACCESS
	bool "Keep firmware-controlled debug access open"
	default y
	---help---
		Open unlocked TAMPC debug signals for SWD/RTT development.
		Signals locked by an earlier boot stage are left unchanged.

menu "GPIO Interrupt Configuration"

config NRF54L_PER_PIN_INTERRUPTS
	bool "Per-pin interrupt callbacks"
	default n
	depends on NRF54L_GPIOTE
	---help---
		Dispatch PORT events to separate callbacks for each pin.

endmenu # GPIO Interrupt Configuration

menu "PWM configuration"

if NRF54L_PWM

config NRF54L_PWM_MULTICHAN
	bool "PWM Multiple Output Channels"
	default n

if NRF54L_PWM_MULTICHAN

if NRF54L_PWM0

config NRF54L_PWM0_CH0
	bool "PWM0 Channel 0 Output"
	default n
	---help---
		Enables channel 0 output.

config NRF54L_PWM0_CH1
	bool "PWM0 Channel 1 Output"
	default n
	---help---
		Enables channel 1 output.

config NRF54L_PWM0_CH2
	bool "PWM0 Channel 2 Output"
	default n
	---help---
		Enables channel 2 output.

config NRF54L_PWM0_CH3
	bool "PWM0 Channel 3 Output"
	default n
	---help---
		Enables channel 3 output.

endif # NRF54L_PWM0

if NRF54L_PWM1

config NRF54L_PWM1_CH0
	bool "PWM1 Channel 0 Output"
	default n
	---help---
		Enables channel 0 output.

config NRF54L_PWM1_CH1
	bool "PWM1 Channel 1 Output"
	default n
	---help---
		Enables channel 1 output.

config NRF54L_PWM1_CH2
	bool "PWM1 Channel 2 Output"
	default n
	---help---
		Enables channel 2 output.

config NRF54L_PWM1_CH3
	bool "PWM1 Channel 3 Output"
	default n
	---help---
		Enables channel 3 output.

endif # NRF54L_PWM1

if NRF54L_PWM2

config NRF54L_PWM2_CH0
	bool "PWM2 Channel 0 Output"
	default n
	---help---
		Enables channel 0 output.

config NRF54L_PWM2_CH1
	bool "PWM2 Channel 1 Output"
	default n
	---help---
		Enables channel 1 output.

config NRF54L_PWM2_CH2
	bool "PWM2 Channel 2 Output"
	default n
	---help---
		Enables channel 2 output.

config NRF54L_PWM2_CH3
	bool "PWM2 Channel 3 Output"
	default n
	---help---
		Enables channel 3 output.

endif # NRF54L_PWM2

endif # NRF54L_PWM_MULTICHAN

if !NRF54L_PWM_MULTICHAN

config NRF54L_PWM0_CHANNEL
	int "PWM0 Output Channel"
	depends on NRF54L_PWM0
	default 0
	range 0 3

config NRF54L_PWM1_CHANNEL
	int "PWM1 Output Channel"
	depends on NRF54L_PWM1
	default 0
	range 0 3

config NRF54L_PWM2_CHANNEL
	int "PWM2 Output Channel"
	depends on NRF54L_PWM2
	default 0
	range 0 3

endif # !NRF54L_PWM_MULTICHAN

endif # NRF54L_PWM

endmenu # PWM configuration

menu "SAADC Configuration"

if NRF54L_SAADC

choice
	prompt "SAADC trigger selection"
	default NRF54L_SAADC_TASK

config NRF54L_SAADC_TASK
	bool "SAADC Task trigger"

config NRF54L_SAADC_TIMER
	bool "SAADC Timer trigger"
	---help---
		Use the local timer for a single channel. Each ANIOC_TRIGGER
		collects one result and then stops the timer.

endchoice # SAADC trigger selection

if NRF54L_SAADC_TIMER

config NRF54L_SAADC_TIMER_CC
	int "SAADC Timer CC"
	default 192
	range 8 2047
	---help---
		Sample rate is 16 MHz / CC. The period must accommodate the
		channel acquisition time plus 2 us conversion time, multiplied
		by the oversampling factor when burst is enabled.

endif # NRF54L_SAADC_TIMER

config NRF54L_SAADC_OVERSAMPLE
	int "SAADC oversample"
	default 0
	range 0 8
	---help---
		Zero disables oversampling; values 1 through 8 select 2 through
		256 samples per result. Scanning multiple channels requires
		burst mode on every channel when oversampling is enabled.

config NRF54L_SAADC_RESOLUTION
	int "SAADC resolution"
	default 0
	range 0 3
	---help---
		SAADC resolution: 0 - 8 bits, 1 - 10 bits, 2 - 12 bits, 3 - 14 bits.

config NRF54L_SAADC_CHANNELS
	int "SAADC channels"
	default 8
	range 1 8

config NRF54L_SAADC_LIMITS
	bool "SAADC limits enable"
	default n
	---help---
		Configure the high and low limit events for each channel.

endif # NRF54L_SAADC

endmenu # SAADC Configuration

menu "SPI Configuration"

if NRF54L_SPI_MASTER

config NRF54L_SPI_MASTER_INTERRUPTS
	bool "SPI Master interrupts support"
	default n

endif # NRF54L_SPI_MASTER

endmenu # SPI Configuration
```

## arch/arm/src/stm32n6/Kconfig
```kconfig
#
# For a description of the syntax of this configuration file,
# see the file kconfig-language.txt in the NuttX tools repository.
#

if ARCH_CHIP_STM32N6

comment "STM32N6 Configuration Options"

config STM32_N6_PERIPHERALS
	bool
	default y
	select STM32_HAVE_IP_ADC_V3_N6
	select STM32_HAVE_IP_DMA_GPDMA
	select STM32_HAVE_IP_EXTI_M33M55_V1
	select STM32_HAVE_IP_GPIO_M33M55_V1
	select STM32_HAVE_IP_I2C_M33M55_V2
	select STM32_HAVE_IP_TIMERS_V3
	select STM32_HAVE_COMMON_PWM
	select STM32_HAVE_TIM_PWM_H7
	select STM32_HAVE_IP_DBGMCU_V8
	select STM32_HAVE_IP_LPTIM_V2
	select STM32_HAVE_IP_LTDC_V2
	select STM32_HAVE_IP_OTG_V2
	select STM32_HAVE_OTGHS_HOST
	select STM32_HAVE_IP_RNG_M3M4_V1
	select STM32_HAVE_IP_RTCC_V3
	select STM32_HAVE_IP_SAI_V2
	select STM32_HAVE_IP_SDMMC_IDMA
	select STM32_HAVE_IP_SPI_V5
	select STM32_HAVE_IP_WDG_V3
	select STM32_HAVE_IP_XSPI_V1
	select STM32_HAVE_ADC2
	select STM32_HAVE_DCMIPP
	select STM32_HAVE_DMA1
	select STM32_HAVE_DMA2
	select STM32_HAVE_ETHERNET
	select STM32_HAVE_ETH_RGMII
	select STM32_HAVE_IP_ETHMAC_V2
	select STM32_HAVE_I2C1
	select STM32_HAVE_I2C2
	select STM32_HAVE_I2C3
	select STM32_HAVE_I2C4
	select STM32_HAVE_LPTIM1
	select STM32_HAVE_LPTIM2
	select STM32_HAVE_LPTIM3
	select STM32_HAVE_LPTIM4
	select STM32_HAVE_LPTIM5
	select STM32_HAVE_LTDC
	select STM32_HAVE_MDF1
	select STM32_HAVE_MDF_AUDIO
	select STM32_HAVE_OTGHS
	select STM32_HAVE_RNG
	select STM32_HAVE_RTC
	select STM32_HAVE_RTC_MAGIC
	select STM32_HAVE_RTC_SUBSECONDS
	select STM32_HAVE_SAI1
	select STM32_HAVE_SDMMC1
	select STM32_HAVE_SDMMC2
	select STM32_HAVE_SPI1
	select STM32_HAVE_SPI2
	select STM32_HAVE_SPI3
	select STM32_HAVE_SPI4
	select STM32_HAVE_SPI5
	select STM32_HAVE_SPI6
	select STM32_HAVE_TIM1
	select STM32_HAVE_TIM2
	select STM32_HAVE_TIM3
	select STM32_HAVE_TIM4
	select STM32_HAVE_TIM5
	select STM32_HAVE_TIM6
	select STM32_HAVE_TIM7
	select STM32_HAVE_TIM8
	select STM32_HAVE_TIM9
	select STM32_HAVE_TIM10
	select STM32_HAVE_TIM11
	select STM32_HAVE_TIM12
	select STM32_HAVE_TIM13
	select STM32_HAVE_TIM14
	select STM32_HAVE_TIM15
	select STM32_HAVE_TIM16
	select STM32_HAVE_TIM17
	select STM32_HAVE_TIM2_32BITS
	select STM32_HAVE_TIM5_32BITS
	select STM32_HAVE_USART1
	select STM32_HAVE_USART2
	select STM32_HAVE_XSPI1
	select STM32_HAVE_XSPI2

config STM32_STM32N6XXXX
	bool
	default y

choice
	prompt "STM32 N6 Chip Selection"
	default ARCH_CHIP_STM32N657X0
	depends on ARCH_CHIP_STM32N6

config ARCH_CHIP_STM32N657X0
	bool "STM32N657X0"
	select ARMV8M_HAVE_ICACHE
	select ARMV8M_HAVE_DCACHE
	select STM32_STM32N6XXXX

endchoice

choice
	prompt "USB OTG HS instance"
	default STM32N6_OTGHS_USB1
	depends on STM32_OTGHS

config STM32N6_OTGHS_USB1
	bool "USB1"
	---help---
		Use USB1 OTG HS and its embedded high speed PHY.

config STM32N6_OTGHS_USB2
	bool "USB2"
	---help---
		Use USB2 OTG HS and its embedded high speed PHY.

endchoice

config STM32N6_DEBUG
	bool "Enable debugger access after boot"
	default n
	---help---
		Reopen secure and non-secure debugger access at the current hardware
		protection level early in startup.  The boot ROM can close this access
		when booting from external flash.  Enable this option for development
		to attach without switching to DEV boot mode.  This changes runtime
		BSEC registers only, not OTP fuses.

menu "DCMIPP Configuration"
	depends on STM32_DCMIPP

config STM32_DCMIPP_AE
	bool "Automatic exposure"
	default y
	select SCHED_LPWORK
	---help---
		Adjust the sensor exposure time, then the gain, from the pipe1
		statistics towards a target mean luminance.

config STM32_DCMIPP_AE_TARGET
	int "Target mean luminance"
	default 46
	range 16 224
	depends on STM32_DCMIPP_AE
	---help---
		Mean luminance (8-bit, linear, before gamma) of the frame.  46 is
		18 % of full scale, the reflectance of a middle grey.

config STM32_DCMIPP_AWB
	bool "Automatic white balance"
	default y
	select SCHED_LPWORK
	---help---
		Grey world white balance: adjust the red and blue gains of the
		pipe1 exposure block until the R, G and B means are equal.

config STM32_DCMIPP_ISP_INTERVAL
	int "Frames skipped after an update"
	default 4
	range 1 60
	depends on STM32_DCMIPP_AE || STM32_DCMIPP_AWB
	---help---
		Frames ignored after each exposure or white balance update; it
		must cover the sensor latency.

endmenu # DCMIPP Configuration

endif # ARCH_CHIP_STM32N6
```

## boards/arm/stm32n6/stm32n6570-dk/Kconfig
```kconfig
#
# For a description of the syntax of this configuration file,
# see the file kconfig-language.txt in the NuttX tools repository.
#

if ARCH_BOARD_STM32N6570_DK

config STM32N6570_DK_CLOCK_HSI
	bool "Run the CPU at 200 MHz from HSI"
	default n
	---help---
		Use the conservative clock tree: PLL1 from the internal 64 MHz HSI,
		CPU 200 MHz, SYSCLK 100 MHz, VOS low.  The default tree runs the CPU
		at 800 MHz from the 48 MHz HSE crystal with VDDCORE overdrive.

config STM32N6570_DK_PSRAM
	bool "XSPI1 PSRAM"
	default n
	select STM32_XSPI1
	---help---
		Initialize the 32 MiB APMemory APS256XXN hexadeca PSRAM on XSPI1 and
		map it at 0x90000000.

config STM32N6570_DK_PSRAM_HEAP
	bool "Add the PSRAM to the heap"
	default y
	depends on STM32N6570_DK_PSRAM
	---help---
		Add the PSRAM to the user heap as an extra region at board bring-up.
		This needs CONFIG_MM_REGIONS >= 2.  Disable it to keep the PSRAM
		free for direct use (e.g. ramtest).

config STM32N6570_DK_NOR
	bool "XSPI2 NOR flash partition"
	default n
	depends on MTD_MX66UW1G45G && MTD_PARTITION
	select STM32_XSPI2
	---help---
		Register the part of the MX66UW1G45G octal NOR boot flash above
		STM32N6570_DK_NOR_OFFSET as /dev/nor and, with littlefs, mount it
		at /data.

config STM32N6570_DK_NOR_OFFSET
	hex "NOR partition offset"
	default 0x1000000
	depends on STM32N6570_DK_NOR
	---help---
		Start of the /dev/nor partition in the NOR flash.  The boot image
		is at the start of the flash and is never written below this
		offset.  Must be 64 KiB aligned and at least 1 MiB.

endif
```
